## oe/build/conf/bblayers.conf
```bitbake
# LAYER_CONF_VERSION is increased each time build/conf/bblayers.conf
# changes incompatibly
LCONF_VERSION = "5"

BBPATH = "${TOPDIR}"
BBFILES ?= ""

# This is really just here to make the README.md instructions easier.
# Feel free to checkout layers wherever you like and adjust the below
# list of paths accordingly.
GITMODULEDIR ?= "${TOPDIR}/.."

BBLAYERS ?= " \
  ${GITMODULEDIR}/oe-core/meta \
  ${GITMODULEDIR}/meta-openembedded/meta-oe \
  ${GITMODULEDIR}/meta-openembedded/meta-python \
  ${GITMODULEDIR}/meta-openembedded/meta-ruby \
  ${GITMODULEDIR}/meta-openembedded/meta-networking \
  ${GITMODULEDIR}/meta-openembedded/meta-webserver \
  ${GITMODULEDIR}/meta-cloud-services \
  ${GITMODULEDIR}/meta-cloud-services/meta-openstack \
  ${GITMODULEDIR}/meta-docker \
  "

BBLAYERS_NON_REMOVABLE ?= " \
  ${GITMODULEDIR}/oe-core/meta \
  "
```

## oe/meta-boxfactory/conf/distro/boxfactory.conf
```bitbake
DISTRO_NAME = "boxfactory"
DISTRO_VERSION ?= "v${@time.strftime('%Y%m', time.gmtime())}"
MAINTAINER = "Angus Lees <gus@inodes.org>"

require conf/distro/include/security_flags.inc

# Limit to basic non-hardware "server" features (no x11, bluetooth, etc).
DISTRO_FEATURES = "argp ext2 largefile xattr ${DISTRO_FEATURES_LIBC}"
# Don't automatically add these
DISTRO_FEATURES_BACKFILL_CONSIDERED += "sysvinit pulseaudio bluez5"
# Neither systemd nor sysvinit
VIRTUAL-RUNTIME_init_manager = "noexist"
INHIBIT_UPDATERCD_BBCLASS = "1"

# Image level user/group configuration.
# Inherit extrausers to make the setting of EXTRA_USERS_PARAMS effective.
INHERIT += "extrausers"
# User / group settings
# The settings are sperated by the ; character.
# Each setting is actually a command. The supported commands are useradd,
# groupadd, userdel, groupdel, usermod and groupmod.
EXTRA_USERS_PARAMS = "\
useradd --user-group --create-home cloud-user; \
"
```

## oe/meta-boxfactory/conf/layer.conf
```bitbake
# We have a conf and classes directory, append to BBPATH
BBPATH .= ":${LAYERDIR}"

# We have a recipes directory, add to BBFILES
BBFILES += "${LAYERDIR}/recipes-*/*/*.bb ${LAYERDIR}/recipes-*/*/*.bbappend"

BBFILE_COLLECTIONS += "boxfactory-layer"
BBFILE_PATTERN_boxfactory-layer := "^${LAYERDIR}/"
BBFILE_PRIORITY_boxfactory-layer = "6"

LAYERDEPENDS_boxfactory-layer = "core"

BB_DANGLINGAPPENDS_WARNONLY ?= "true"
```

## oe/meta-boxfactory/conf/machine/docker-linux-x86_64.conf
```bitbake
# Regular docker x86_86/Linux configuration

DEFAULTTUNE ?= "core2-64"
require conf/machine/include/tune-core2.inc

MACHINE_FEATURES += "x86"

IMAGE_FSTYPES += "tar.xz"

# Don't include kernels in standard images
RDEPENDS_kernel-base = ""
```

## oe/meta-docker/conf/layer.conf
```bitbake
# We have a conf and classes directory, add to BBPATH
BBPATH .= ":${LAYERDIR}"

# We have a recipes directory, add to BBFILES
BBFILES += "${LAYERDIR}/recipes-*/*/*.bb ${LAYERDIR}/recipes-*/*/*.bbappend"

BBFILE_COLLECTIONS += "docker"
BBFILE_PATTERN_docker := "^${LAYERDIR}/"
BBFILE_PRIORITY_docker = "6"

BB_DANGLINGAPPENDS_WARNONLY ?= "true"
```
